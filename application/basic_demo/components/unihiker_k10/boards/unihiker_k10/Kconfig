## application/basic_demo/components/unihiker_k10/boards/unihiker_k10/Kconfig
```kconfig
config BOARD_UNIHIKER_K10
    bool "UNIHIKER K10 (DFRobot ESP32-S3 AI Board)"
    depends on SOC_ESP32S3
    help
        UNIHIKER K10 with 2.8" ILI9341 LCD, GC2145 Camera,
        dual mics, speaker, RGB LEDs, and onboard sensors.
```

## application/basic_demo/components/unihiker_k10/boards/unihiker_k10/sdkconfig.defaults.board
```kconfig
CONFIG_ESPTOOLPY_FLASHSIZE_16MB=y
CONFIG_SPIRAM=y
CONFIG_SPIRAM_MODE_OCT=y
CONFIG_CODEC_DUMMY_SUPPORT=y
CONFIG_CODEC_ES7243E_SUPPORT=y
CONFIG_CAMERA_GC2145=y
CONFIG_CAMERA_GC2145_AUTO_DETECT_DVP_INTERFACE_SENSOR=y
CONFIG_CAMERA_GC2145_DVP_RGB565_BE_800X600_20FPS=y
CONFIG_CAMERA_GC2145_DVP_DEFAULT_FMT_RGB565_BE_800X600_20FPS=y
CONFIG_ESP_VIDEO_ENABLE_DVP_VIDEO_DEVICE=y
```
